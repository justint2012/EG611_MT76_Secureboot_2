## uboot/board/mediatek/mt7622/Kconfig
```kconfig
if TARGET_MT7622

config SYS_BOARD
	default "mt7622"

config SYS_CONFIG_NAME
	default "mt7622"

endif
```

## uboot/board/mediatek/mt7981/Kconfig
```kconfig
if TARGET_MT7981

config SYS_BOARD
	default "mt7981"

config SYS_CONFIG_NAME
	default "mt7981"

endif
```

## uboot/board/mediatek/mt7986/Kconfig
```kconfig
if TARGET_MT7986

config SYS_BOARD
	default "mt7986"

config SYS_CONFIG_NAME
	default "mt7986"

endif
```

## uboot/board/mediatek/mt7988/Kconfig
```kconfig
if TARGET_MT7988

config SYS_BOARD
	default "mt7988"

config SYS_CONFIG_NAME
	default "mt7988"

endif
```
